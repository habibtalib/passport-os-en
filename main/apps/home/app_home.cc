// Home (personal page) app.
//
// Three hard rules under the small-memory constraint (keep them when changing code):
//   1. The avatar index is stored statically; display buffers are allocated only on Home and freed on leaving;
//   2. File IO (reading the avatar) and network IO (fetching weather) always happen **without holding the LVGL lock**;
//   3. stop() must delete the screen, for the same reason as the Launcher's launcher_ui_hide(): the C3 internal heap has no room
//      to hold the UIs of two apps at once.
//
// 2026-09-13 visual polish (all "object-built drawings + low-frequency animation", no canvas/image assets):
//   - Day/night theme: the task checks hourly, 19:00 to 06:00 switches to the night scene (ui_pixel theme system);
//   - The weather card draws a pixel weather icon on its left (clear/partly cloudy/overcast/fog/rain/snow/thunder), and shows a four-dot spinner while fetching;
//   - The empty no-avatar state uses the device mascot (a blinking pixel TV) instead of a gray silhouette;
//   - Bottom white text gets an ink-colored offset hard shadow so it stays legible over grass.
//
// 2026-09-13 evening - Home layout rework (top/middle/bottom layers, finalized by the user):
//   Top: big pixel-block clock (5x7 glyphs assembled from blocks, truly pixel-bold, drawn directly on the sky) + date row;
//   Middle: combined card = avatar on the left (orange frame) + on the right weather icon/phrase + city + temperature + one humidity/wind-level row
//        (the former two stat cards are folded into this row);
//   Bottom: name card = name (20px title font) + signature, floating over the sky, grass keeps only the key hints.
//
// 2026-09-13 late night - green-phosphor lock-screen revamp (based on the user's retro-terminal reference image):
//   Whole page black background + single-color phosphor green, three-column layout:
//   Left card (104x202): portrait area (96x140, avatar converted to A8 monochrome by a brightness threshold) + name + signature;
//   Right column (120 wide): dot-matrix clock card (5x7 glyphs, each cell drawn as a 4x4 light dot) / date+city+Wi-Fi card /
//                weather card (monochrome icon + temperature + phrase + divider + wind direction/level);
//   Bottom: 240x108 A8 art image full-width bleed (generated by tools/gen_band_art.py, two built in,
//        long-press Up to switch), battery floats at the top right of the art, key hints sit on the black strip at the art's lower edge.
//   Art display uses the LVGL A8 fast path (alpha mask + image_recolor solid color), checked against
//   lv_draw_sw_img.c:233 and lv_draw_sw_blend_to_rgb565.c.
#include "apps/home/app_home.h"

#include "apps/home/band_art.h"
#include "apps/home/home_clock.h"
#include "apps/home/home_profile.h"
#include "apps/home/home_upload.h"
#include "apps/home/home_weather.h"
#include "apps/voice/time_sync.h"
#include "launcher/app_registry.h"
#include "bsp_display.h"
#include "esp_lcd_panel_io.h"
#include "esp_lcd_panel_ops.h"
#include "src/libs/tjpgd/tjpgd.h"
#include "src/misc/cache/instance/lv_image_cache.h"
#include "fonts/app_fonts.h"   // buddy_font_16: Home's dynamic text relies on it
#include "ui_pixel.h"
#include "ui/pixel_scene.h"
#include "wifi_manager.h"
#include "esp_log.h"
#include "esp_system.h"
#include "esp_heap_caps.h"
#include "esp_timer.h"
#include "freertos/FreeRTOS.h"
#include "freertos/task.h"
#include "lvgl.h"

extern "C" {
#include "bsp_battery.h"
}

#include <algorithm>
#include <ctime>
#include <atomic>
#include <cstdio>
#include <cstdlib>
#include <cstring>
#include <string>

namespace {

constexpr char kTag[] = "app_home";
LV_FONT_DECLARE(lv_font_unscii_8);

// A8 artwork encodes highlights: keep a dark home scene even in the light theme.
#define kBg (ui_theme_color_on_dark(UI_COLOR_BG))
#define kPhos (ui_theme_color_on_dark(UI_COLOR_TEXT))
#define kPhosDim (ui_theme_color_on_dark(UI_COLOR_TEXT_DIM))
#define kPhosBorder (ui_theme_color_on_dark(UI_COLOR_BORDER))
#define kClock (ui_theme_get() == UI_THEME_NEON ? UI_ACCENT : ui_theme_get() == UI_THEME_PLAYFUL ? ui_theme_color_on_dark(UI_COLOR_SECONDARY) : kPhos)
#define kBand (ui_theme_get() == UI_THEME_NEON ? UI_SECONDARY : ui_theme_get() == UI_THEME_PLAYFUL ? ui_theme_color_on_dark(UI_COLOR_SUCCESS) : UI_AMBER)
#define kTemperature (ui_theme_is_multicolor() ? ui_theme_color_on_dark(UI_COLOR_TERTIARY) : kPhos)
#define kWeatherAccent (ui_theme_color_on_dark(ui_theme_get() == UI_THEME_NEON ? UI_COLOR_SUCCESS : UI_COLOR_ACCENT))

// Semantic colors for the existing update functions: in the phosphor style both "accent/online" are bright green and "dimmed" is dark green.
#define kText (kPhos)
#define kSub (kPhosDim)
#define kMuted (kPhosDim)
#define kAccent (kPhos)
#define kOnline (kPhos)
#define kOffline (kPhosDim)

// Layout grid: every element hangs off these constants, change one margin and the whole screen follows, no scattered hard-coding.
constexpr int kMargin = 12;
constexpr int kContentW = 240 - kMargin * 2;  // 216

constexpr int64_t kWeatherFirstDelayMs = 15000;
constexpr int64_t kWeatherPeriodMs = 1800000;
// After a failure (weak signal / hotspot just connected) retry in 2 minutes instead of waiting 30 minutes.
constexpr int64_t kWeatherRetryMs = 120000;
// Weather older than 2 hours switches the wind row to "updated N hours ago", so outdoors without network stale data is not taken as live.
constexpr int64_t kWeatherStaleSec = 7200;
constexpr int64_t kUploadTimeoutMs = 600000;

// Only the Home worker owns this state. Keep deadlines across app visits so a
// fresh sample does not cause another pair of TLS requests on every return.
struct WeatherSchedule {
    static constexpr unsigned Weather = 1, Air = 2, Both = Weather | Air;
    int64_t weather_due_ms = -1, air_due_ms = -1;
    char lat[HOME_COORD_MAX]{}, lon[HOME_COORD_MAX]{};

    unsigned due(int64_t now, int64_t entered, bool force, const home_profile_t &profile) const {
        if (!profile.lat[0] || !profile.lon[0]) return 0;
        if (force || (lat[0] && (std::strcmp(lat, profile.lat) || std::strcmp(lon, profile.lon)))) return Both;
        if (weather_due_ms < 0 && air_due_ms < 0) return now - entered >= kWeatherFirstDelayMs ? Both : 0;
        return (weather_due_ms <= now ? Weather : 0u) | (air_due_ms <= now ? Air : 0u);
    }

    void begin(unsigned requests, int64_t now, const home_profile_t &profile) {
        std::snprintf(lat, sizeof(lat), "%s", profile.lat);
        std::snprintf(lon, sizeof(lon), "%s", profile.lon);
        // An interrupted request stays due when the next Home worker starts.
        if (requests & Weather) weather_due_ms = now;
        if (requests & Air) air_due_ms = now;
    }

    void finish(unsigned request, int64_t now, esp_err_t result) {
        const int64_t next = now + (request == Weather && result != ESP_OK ? kWeatherRetryMs : kWeatherPeriodMs);
        if (request == Weather) weather_due_ms = next;
        else air_due_ms = next;
    }
};
WeatherSchedule s_weather_schedule;

// Packed two-bit tone indices; the theme supplies colors at display time.
// Home owns this buffer only while its screen/worker are alive.
uint8_t *s_portrait_packed = nullptr;

esp_err_t read_portrait(bool present) {
    if (!present) return ESP_FAIL;
    if (!s_portrait_packed)
        s_portrait_packed = static_cast<uint8_t *>(malloc(HOME_AVATAR_BYTES));
    if (!s_portrait_packed) return ESP_ERR_NO_MEM;
    return home_profile_read_avatar(s_portrait_packed, HOME_AVATAR_BYTES);
}
// Display uses A8 expansion: LVGL software-rendering A8 fast path (alpha mask + recolor to phosphor green solid).
// 2026-09-13 changed to heap allocation (home_start allocates / home_stop returns): 14.4KB resident .bss
// would be deducted straight from the heap, and apps like Xiaozhi run the Opus encoder on exactly that memory -- previously
// the largest block was only 22KB, so the encoder (needs about a 25KB contiguous block) was bound to fail to open. Home and the other
// apps run mutually exclusively and give the memory back on switching away: whoever uses it pays for it.
uint8_t *s_portrait_pixels = nullptr;
lv_image_dsc_t s_portrait_dsc;

std::atomic<bool> s_home_active{false};
// UI-alive flag: home_task checks it each round before refreshing under the lock, stop() sets it false before deleting the screen.
// Fixes the use-after-free class "task still alive after stop timed out and writes to a deleted label".
std::atomic<bool> s_ui_alive{false};
std::atomic<bool> s_force_weather{false};
int64_t s_manual_weather_ms = -30000;
TaskHandle_t s_task_handle = nullptr;
std::atomic<bool> s_worker_running{false};
uint8_t s_detail_mode = 0;

lv_obj_t *s_screen = nullptr;
lv_obj_t *s_avatar_img = nullptr;      // Indexed portrait with a transparent background.
lv_obj_t *s_portrait_ph = nullptr;     // No-avatar placeholder text
lv_obj_t *s_lbl_date = nullptr;
lv_obj_t *s_wifi_bars[3] = {nullptr, nullptr, nullptr};
ui_pixel_battery_t s_batt = {nullptr, nullptr};
lv_obj_t *s_band_img = nullptr;        // Bottom art image
bool s_share_visible = false;
uint8_t s_share_index = 0;

// ---- Pixel dot-matrix clock: 4 digit slots + colon slot (slot 2), 5x7 glyphs, one 4x4 light dot per cell ----
lv_obj_t *s_clk_slots[5] = {nullptr, nullptr, nullptr, nullptr, nullptr};
lv_obj_t *s_clk_colon[2] = {nullptr, nullptr};   // Two colon dots, breathing every second
char s_clk_slot_char[5] = {0, 0, 0, 0, 0};       // Current character of each slot, redrawn only on change
bool s_clk_colon_on = false;

lv_obj_t *s_lbl_name = nullptr;
lv_obj_t *s_lbl_sig = nullptr;
lv_obj_t *s_wicon_zone = nullptr;    // Weather icon drawing area (22x18 inside the weather card)
lv_obj_t *s_lbl_city = nullptr;
lv_obj_t *s_lbl_wtext = nullptr;
lv_obj_t *s_lbl_temp = nullptr;
lv_obj_t *s_lbl_humidity = nullptr;  // Humidity (grid row 1, left)
lv_obj_t *s_lbl_wind = nullptr;      // Wind (grid row 1, right)
lv_obj_t *s_lbl_feels = nullptr;     // Feels-like (grid row 2, left)
lv_obj_t *s_lbl_stat = nullptr;      // Status (grid row 2, right)
lv_obj_t *s_lbl_footer = nullptr;

// Bottom art image: 0=city night view 1=mountain lake moonlight (both built into flash); a user upload slot may be added later.
uint8_t s_band_index = 0;
lv_image_dsc_t s_band_dsc[2];

// ---- Pixel weather icons (drawn inside s_wicon_zone, all color blocks) ----
constexpr int kWiMax = 12;
lv_obj_t *s_wicon_objs[kWiMax] = {};
int s_wicon_n = 0;
lv_obj_t *s_spin[4] = {nullptr, nullptr, nullptr, nullptr};  // Four-dot spinner
uint8_t s_spin_phase = 0;
bool s_wicon_spinning = false;
bool s_weather_fetching = false;

void expand_portrait(void) {
    if (!s_portrait_pixels || !s_portrait_packed) return;
    lv_image_cache_drop(&s_portrait_dsc);
    if (s_portrait_packed[4] == 0) {
        // Preserve LVGL's original RGB565 alpha blending, including its rounding.
        for (size_t pixel = 0; pixel < HOME_PORTRAIT_PIXELS; ++pixel)
            s_portrait_pixels[pixel] = home_portrait_index(s_portrait_packed, pixel) * 85;
        return;
    }
    memset(s_portrait_pixels, 0, HOME_PORTRAIT_I4_BYTES);
    auto *palette = reinterpret_cast<lv_color32_t *>(s_portrait_pixels);
    for (uint8_t i = 1; i <= 4; ++i)
        palette[i] = lv_color_to_32(lv_color_hex(ui_theme_portrait_subject_color(i - 1)), LV_OPA_COVER);
    for (size_t pixel = 0; pixel < HOME_PORTRAIT_PIXELS; pixel += 2)
        s_portrait_pixels[64 + pixel / 2] = (home_portrait_index(s_portrait_packed, pixel) << 4) |
            home_portrait_index(s_portrait_packed, pixel + 1);
}

// Show placeholder text when there is no avatar (the phosphor style does not use the colored mascot).
void apply_avatar(bool have_image) {
    have_image = have_image && s_portrait_packed;
    const bool legacy = have_image && s_portrait_packed[4] == 0;
    const size_t bytes = legacy ? HOME_PORTRAIT_PIXELS : HOME_PORTRAIT_I4_BYTES;
    if (have_image && s_portrait_pixels && s_portrait_dsc.data_size != bytes) {
        lv_image_set_src(s_avatar_img, nullptr);
        lv_image_cache_drop(&s_portrait_dsc);
        free(s_portrait_pixels);
        s_portrait_pixels = nullptr;
    }
    if (have_image && !s_portrait_pixels) {
        s_portrait_pixels = static_cast<uint8_t *>(malloc(bytes));
        s_portrait_dsc.data = s_portrait_pixels;
        if (!s_portrait_pixels) ESP_LOGW(kTag, "portrait buffer unavailable; using placeholder");
    }
    if (have_image && s_portrait_pixels != nullptr) {
        s_portrait_dsc.header.cf = legacy ? LV_COLOR_FORMAT_A8 : LV_COLOR_FORMAT_I4;
        s_portrait_dsc.header.stride = legacy ? HOME_PORTRAIT_W : HOME_PORTRAIT_W / 2;
        s_portrait_dsc.data_size = bytes;
        lv_obj_set_style_image_recolor(s_avatar_img, lv_color_hex(ui_theme_portrait_color(3)), 0);
        expand_portrait();
        lv_image_set_src(s_avatar_img, &s_portrait_dsc);
        lv_obj_clear_flag(s_avatar_img, LV_OBJ_FLAG_HIDDEN);
        if (s_portrait_ph) lv_obj_add_flag(s_portrait_ph, LV_OBJ_FLAG_HIDDEN);
    } else {
        lv_image_set_src(s_avatar_img, nullptr);
        lv_obj_add_flag(s_avatar_img, LV_OBJ_FLAG_HIDDEN);
        if (s_portrait_ph) lv_obj_clear_flag(s_portrait_ph, LV_OBJ_FLAG_HIDDEN);
    }
}

// ---- Pixel weather icons: WMO code -> assembled blocks, same visual language as the device's "building block" icons ----
void update_weather_labels(const home_profile_t *prof);  // defined after this section

lv_obj_t *px_container(lv_obj_t *parent, int x, int y, int w, int h) {
    lv_obj_t *o = lv_obj_create(parent);
    lv_obj_remove_flag(o, LV_OBJ_FLAG_SCROLLABLE);
    lv_obj_set_pos(o, x, y);
    lv_obj_set_size(o, w, h);
    lv_obj_set_style_bg_opa(o, LV_OPA_TRANSP, 0);
    lv_obj_set_style_border_width(o, 0, 0);
    lv_obj_set_style_pad_all(o, 0, 0);
    return o;
}

lv_obj_t *px_block(lv_obj_t *parent, int x, int y, int w, int h, uint32_t color) {
    lv_obj_t *o = lv_obj_create(parent);
    lv_obj_remove_flag(o, LV_OBJ_FLAG_SCROLLABLE);
    lv_obj_set_pos(o, x, y);
    lv_obj_set_size(o, w, h);
    lv_obj_set_style_radius(o, 0, 0);
    lv_obj_set_style_border_width(o, 0, 0);
    lv_obj_set_style_pad_all(o, 0, 0);
    lv_obj_set_style_bg_color(o, lv_color_hex(color), 0);
    return o;
}

lv_obj_t *wicon_block(int x, int y, int w, int h, uint32_t color) {
    if (s_wicon_n >= kWiMax || !s_wicon_zone) return nullptr;
    // Phosphor monochrome: "bright/ink" in the original palette map to bright green, gray-blue tones map to dark green (monochrome icons still have depth)
    color = (color == UI_INK || color == UI_YELLOW || color == UI_ORANGE ||
             color == 0xFFFFFF)
                ? kPhos
                : kPhosDim;
    lv_obj_t *o = px_block(s_wicon_zone, x, y, w, h, color);
    s_wicon_objs[s_wicon_n++] = o;
    return o;
}

void wicon_clear(void) {
    if (!s_ui_alive.load() || s_screen == nullptr) {
        s_wicon_n = 0;
        for (lv_obj_t *&b : s_spin) b = nullptr;
        s_wicon_spinning = false;
        return;
    }
    for (int i = 0; i < s_wicon_n; ++i) {
        if (s_wicon_objs[i]) lv_obj_delete(s_wicon_objs[i]);
        s_wicon_objs[i] = nullptr;
    }
    s_wicon_n = 0;
    for (lv_obj_t *&b : s_spin) b = nullptr;
    s_wicon_spinning = false;
}

// Three-part cloud + ink shadow, reusable in the overcast/rain/snow/thunder/fog icons
void wicon_cloud(int x, int y, uint32_t body) {
    wicon_block(x, y + 6, 18, 5, body);
    wicon_block(x + 3, y + 3, 9, 5, body);
    wicon_block(x + 9, y, 8, 5, body);
    wicon_block(x + 1, y + 11, 16, 2, UI_INK);
}

void wicon_sun(void) {
    wicon_block(7, 4, 8, 8, UI_YELLOW);   // Sun core
    wicon_block(10, 0, 3, 3, UI_ORANGE);  // Four-way rays
    wicon_block(10, 13, 3, 3, UI_ORANGE);
    wicon_block(2, 7, 3, 3, UI_ORANGE);
    wicon_block(17, 7, 3, 3, UI_ORANGE);
    wicon_block(3, 1, 2, 2, UI_YELLOW);   // Diagonal light dots
    wicon_block(18, 1, 2, 2, UI_YELLOW);
    wicon_block(3, 13, 2, 2, UI_YELLOW);
    wicon_block(18, 13, 2, 2, UI_YELLOW);
}

void wicon_sun_cloud(void) {
    wicon_block(13, 0, 7, 7, UI_YELLOW);  // Sun at upper right (lower half covered by the cloud)
    wicon_block(20, 2, 2, 2, UI_YELLOW);
    wicon_cloud(0, 4, 0xFFFFFF);
}

void weather_icon_draw(uint16_t code) {
    wicon_clear();
    if (code == 0) { wicon_sun(); return; }
    if (code == 1 || code == 2) { wicon_sun_cloud(); return; }
    if (code == 3) { wicon_cloud(2, 1, 0xB9C4CC); return; }              // overcast
    if (code == 45 || code == 48) {                                       // fog
        wicon_cloud(2, 0, 0xC6CED4);
        wicon_block(4, 14, 14, 2, UI_SUB);
        return;
    }
    if ((code >= 51 && code <= 67) || (code >= 80 && code <= 82)) {       // rain
        wicon_cloud(2, 0, 0x9AA7B4);
        wicon_block(4, 14, 2, 3, UI_SKY_DARK);
        wicon_block(9, 14, 2, 3, UI_SKY_DARK);
        wicon_block(14, 14, 2, 3, UI_SKY_DARK);
        return;
    }
    if ((code >= 71 && code <= 77) || code == 85 || code == 86) {         // snow
        wicon_cloud(2, 0, 0xD7DEE4);
        wicon_block(4, 14, 2, 2, 0x8FC7EF);
        wicon_block(9, 14, 2, 2, 0x8FC7EF);
        wicon_block(14, 14, 2, 2, 0x8FC7EF);
        return;
    }
    if (code >= 95) {                                                     // thunder
        wicon_cloud(2, 0, 0x8B98A5);
        wicon_block(9, 13, 3, 2, UI_YELLOW);
        wicon_block(8, 15, 2, 2, UI_YELLOW);
        return;
    }
    wicon_cloud(2, 1, 0xB9C4CC);
}

// Four-dot spinner while fetching: four blocks light up in turn, advanced by Home's 1s tick
void weather_spinner_draw(void) {
    wicon_clear();
    s_spin[0] = wicon_block(9, 1, 4, 3, UI_INK);
    s_spin[1] = wicon_block(15, 7, 3, 4, 0xB9C2B0);
    s_spin[2] = wicon_block(9, 13, 4, 3, 0xB9C2B0);
    s_spin[3] = wicon_block(4, 7, 3, 4, 0xB9C2B0);
    s_spin_phase = 0;
    s_wicon_spinning = true;
}

void weather_icon_spin_tick(void) {
    if (!s_wicon_spinning || !s_ui_alive.load() || s_screen == nullptr) return;
    s_spin_phase = (s_spin_phase + 1) & 3;
    for (int i = 0; i < 4; ++i) {
        if (s_spin[i]) {
            lv_obj_set_style_bg_color(
                s_spin[i], lv_color_hex(i == s_spin_phase ? kPhos : kPhosDim), 0);
        }
    }
}

// Refresh the whole weather area: text rows + left icon. The caller must already hold the LVGL lock.
void refresh_weather_ui(void) {
    if (!s_ui_alive.load() || s_screen == nullptr) return;
    home_profile_t prof;
    home_profile_get(&prof);
    update_weather_labels(&prof);
    if (prof.lat[0] == '\0') {
        wicon_clear();                       // No city set: leave only the text hint
    } else if (s_weather_fetching) {
        weather_spinner_draw();
    } else {
        home_weather_t w;
        if (home_weather_get(&w) && w.valid) {
            weather_icon_draw(w.code);
        } else {
            wicon_clear();                   // No data: draw nothing, the text will hint "fetching"
        }
    }
}

// ---- Dot-matrix clock ----
// 5x7 glyphs (row bit masks, bit4 = leftmost column), each lit cell draws a 4x4 light dot (cell pitch 5),
// giving an LED dot-matrix feel consistent with the phosphor lock-screen reference. Needs no font file.
constexpr int kCell = 5;             // Cell pitch -> digit 25x35
constexpr int kDot = 4;              // Dot edge length (1px gap gives the dot-matrix look)
constexpr int kDigitW = 5 * kCell;   // 25
constexpr int kClockH = 7 * kCell;   // 35
constexpr uint8_t kDashGlyphIdx = 10;
const uint8_t kDigitGlyphs[11][7] = {
    {0x1F, 0x11, 0x11, 0x11, 0x11, 0x11, 0x1F},  // 0
    {0x04, 0x0C, 0x04, 0x04, 0x04, 0x04, 0x0E},  // 1
    {0x1F, 0x01, 0x01, 0x1F, 0x10, 0x10, 0x1F},  // 2
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    {0x00, 0x00, 0x00, 0x0E, 0x00, 0x00, 0x00},  // '-' placeholder
};

// Draw the same pixel glyph directly. A digit no longer owns 10-25 child
// objects, and a minute change no longer frees/reallocates their styles.
void draw_digit_event(lv_event_t *event) {
    auto *slot = static_cast<lv_obj_t *>(lv_event_get_target(event));
    const char c = *static_cast<const char *>(lv_event_get_user_data(event));
    lv_area_t origin;
    lv_obj_get_coords(slot, &origin);
    lv_draw_rect_dsc_t ink;
    lv_draw_rect_dsc_init(&ink);
    ink.bg_color = lv_color_hex(kClock);
    ink.bg_opa = LV_OPA_COVER;
    int idx = kDashGlyphIdx;
    if (c >= '0' && c <= '9') idx = c - '0';
    for (int r = 0; r < 7; ++r) {
        for (int col = 0; col < 5; ++col) {
            if (kDigitGlyphs[idx][r] & (0x10 >> col)) {
                const int x = origin.x1 + col * kCell, y = origin.y1 + r * kCell;
                const lv_area_t dot = {x, y, x + kDot - 1, y + kDot - 1};
                lv_draw_rect(lv_event_get_layer(event), &ink, &dot);
            }
        }
    }
}

// Redraw digit slots + date + colon breathing every second (the only per-second action in the clock area, only changes opa, no relayout)
void update_clock_labels() {
    char hh[3] = "--";
    char mm[3] = "--";
    char date_buf[24];
    const bool valid = home_clock_valid();
    if (valid) {
        char time_buf[8];
        home_clock_format_time(time_buf, sizeof(time_buf));
        hh[0] = time_buf[0];
        hh[1] = time_buf[1];
        mm[0] = time_buf[3];
        mm[1] = time_buf[4];
        char ymd[16];
        char week[8];
        home_clock_format_date(ymd, sizeof(ymd));
        home_clock_format_weekday(week, sizeof(week));
        std::snprintf(date_buf, sizeof(date_buf), "%s %s", ymd, week);
    } else {
        // When unsynced always show a placeholder. Time can only come from SNTP or a PC time sync; the device has no trustworthy source of its own.
        std::snprintf(date_buf, sizeof(date_buf), "Waiting sync");
    }

    const char digits[4] = {hh[0], hh[1], mm[0], mm[1]};
    const int slot_map[4] = {0, 1, 3, 4};   // Slot 2 is the colon
    for (int i = 0; i < 4; ++i) {
        const int slot = slot_map[i];
        if (s_clk_slots[slot] && s_clk_slot_char[slot] != digits[i]) {
            s_clk_slot_char[slot] = digits[i];
            lv_obj_invalidate(s_clk_slots[slot]);
        }
    }
    ui_pixel_label_set_text(s_lbl_date, date_buf);

    s_clk_colon_on = !s_clk_colon_on;
    for (lv_obj_t *dot : s_clk_colon) {
        if (dot) {
            lv_obj_set_style_opa(dot, s_clk_colon_on ? LV_OPA_COVER : LV_OPA_30, 0);
        }
    }
}

// The battery is drawn as a 24x12 mini battery: outline + inner bar scaled by SOC + percentage number on the right.
// It takes two more objects than a plain "78%", but the remaining charge reads at a glance, which is worth it.
// The top-bar battery and Wi-Fi signal both use the shared pixel widgets, consistent with the Launcher/AI Voice top bar.
void update_battery_label() {
    ui_pixel_battery_set_on_dark(&s_batt, bsp_battery_soc());

    const bool connected = WifiManager::GetInstance().IsConnected();
    int bars = 0;
    uint32_t color = kOffline;
    if (connected) {
        const int rssi = WifiManager::GetInstance().GetRssi();
        bars = rssi >= -60 ? 3 : (rssi >= -75 ? 2 : 1);
        color = kOnline;
    }
    ui_pixel_wifi_bars_set(s_wifi_bars, bars, color);
}

// Weather is split in three parts: city (dim) / weather phrase (secondary) / temperature (accent color + 20px digits).
// Temperature uses montserrat rather than the CJK font because digit glyphs like "24°" are much finer than the CJK dot-matrix.
void update_weather_labels(const home_profile_t *prof) {
    if (!s_ui_alive.load() || s_lbl_city == nullptr) return;
    char pm_line[32];
    home_air_quality_label(WifiManager::GetInstance().IsConnected(), pm_line, sizeof(pm_line));
    if (s_lbl_stat) lv_label_set_text(s_lbl_stat, pm_line);
    if (prof->lat[0] == '\0') {
        lv_label_set_text(s_lbl_city, "Set city");
        lv_label_set_text(s_lbl_wtext, "");
        lv_label_set_text(s_lbl_temp, "--");
        if (s_lbl_humidity) lv_label_set_text(s_lbl_humidity, "Humid --");
        if (s_lbl_feels) lv_label_set_text(s_lbl_feels, "Feels --");
        return;
    }
    home_weather_t w;
    const bool ok = home_weather_get(&w);
    lv_label_set_text(s_lbl_city, prof->city);
    if (ok && w.valid) {
        lv_label_set_text(s_lbl_wtext, home_weather_code_text(w.code));
        char t[12];
        std::snprintf(t, sizeof(t), "%d°", static_cast<int>(w.temp_c));
        lv_label_set_text(s_lbl_temp, t);

        char h[20];
        std::snprintf(h, sizeof(h), "Humid %u%%", (unsigned)w.humidity);
        if (s_lbl_humidity) lv_label_set_text(s_lbl_humidity, h);

        int feels = static_cast<int>(w.temp_c);
        if (w.temp_c >= 25 && w.humidity > 60) {
            feels += (w.humidity - 60) / 12;
        } else if (w.temp_c < 15 && w.wind_kmh > 15) {
            feels -= (w.wind_kmh - 15) / 10;
        }
        char f[20];
        std::snprintf(f, sizeof(f), "Feels %d°", feels);
        if (s_lbl_feels) lv_label_set_text(s_lbl_feels, f);

    } else {
        lv_label_set_text(s_lbl_wtext, s_weather_fetching ? "Sync" : "N/A");
        lv_label_set_text(s_lbl_temp, "--");
        if (s_lbl_humidity) lv_label_set_text(s_lbl_humidity, "Humid --");
        if (s_lbl_feels) lv_label_set_text(s_lbl_feels, "Feels --");
    }
}

// Weather card wind row: wind direction + Beaufort level (e.g. N Bft 3).
void update_wind_line() {
    if (!s_ui_alive.load() || s_lbl_wind == nullptr) return;
    if (s_lbl_stat) {
        char line[32];
        home_air_quality_label(WifiManager::GetInstance().IsConnected(), line, sizeof(line));
        ui_pixel_label_set_text(s_lbl_stat, line);
    }
    home_weather_t w;
    if (home_weather_get(&w) && w.valid) {
        char line[40];
        const int64_t now = static_cast<int64_t>(std::time(nullptr));
        const bool unknown_age = w.updated_at == 0 || !home_clock_valid();
        const bool stale = unknown_age
            ? !WifiManager::GetInstance().IsConnected()
            : now - static_cast<int64_t>(w.updated_at) >= kWeatherStaleSec;
        if (stale) {
            char age[24];
            home_weather_age_text(w.updated_at, unknown_age ? 0 : now, age, sizeof(age));
            if (unknown_age) std::snprintf(line, sizeof(line), "%s", age);
            else std::snprintf(line, sizeof(line), "Upd %s", age);
        } else {
            std::snprintf(line, sizeof(line), "%s Bft %d",
                          home_weather_wind_dir_text(w.wind_dir),
                          home_weather_beaufort(w.wind_kmh));
        }
        ui_pixel_label_set_text(s_lbl_wind, line);
    } else {
        ui_pixel_label_set_text(s_lbl_wind, "Wind --");
    }
}

// The bottom row rotates between "key hints / upload hint / details" (Down key switches),
// upload mode has the highest priority -- the user is staring at the phone scanning the QR code and must see the URL immediately.
// Key hints are dimmed and pushed back (consistent with other pages); info rows such as IP/PM2.5/upload address stay bright.
void footer_set(const char *text, const lv_font_t *font, uint32_t color) {
    if (lv_obj_get_style_text_font(s_lbl_footer, LV_PART_MAIN) != font)
        lv_obj_set_style_text_font(s_lbl_footer, font, 0);
    ui_pixel_text_color(s_lbl_footer, color);
    ui_pixel_label_set_text(s_lbl_footer, text);

}

void update_footer_label() {
    if (home_upload_active()) {
        footer_set(home_upload_url(), &lv_font_montserrat_14, kPhos);
        return;
    }

    if (s_detail_mode == 1) {
        footer_set("Hold Up:art Dn:setup", &buddy_font_16, kPhosDim);
        return;
    }
    if (s_detail_mode == 2) {
        if (!WifiManager::GetInstance().IsConnected()) {
            footer_set("Wi-Fi not connected", &buddy_font_16, kPhos);
            return;
        }
        home_weather_t w;
        const bool ok = home_weather_get(&w);
        const std::string ip = WifiManager::GetInstance().GetIpAddress();
        char line[48];
        char age[24] = "No weather";
        if (ok && w.valid) {
            home_weather_age_text(w.updated_at,
                                  home_clock_valid() ? static_cast<int64_t>(std::time(nullptr)) : 0,
                                  age, sizeof(age));
        }
        std::snprintf(line, sizeof(line), "%s · OK: refresh", age);
        footer_set(line, &buddy_font_16, kPhos);
        return;
    }
    if (s_detail_mode == 3) {
        home_air_quality_t air;
        if (WifiManager::GetInstance().IsConnected() && home_air_quality_get(&air)) {
            char line[48];
            std::snprintf(line, sizeof(line), "PM2.5 %u.%u ug/m3",
                          (unsigned)(air.pm25_x10 / 10), (unsigned)(air.pm25_x10 % 10));
            footer_set(line, &lv_font_montserrat_14, kPhos);
        } else {
            footer_set("PM2.5 no data", &buddy_font_16, kPhos);
        }
        return;
    }
    if (s_detail_mode == 4) {
        footer_set("Open-Meteo/CAMS est.", &buddy_font_16, kPhos);
        return;
    }
    footer_set("Up:card Dn:info OK:apps", &buddy_font_16, kPhosDim);
}

void apply_profile(const home_profile_t *prof) {
    lv_label_set_text(s_lbl_name, prof->name[0] ? prof->name : "No name");
    lv_label_set_text(s_lbl_sig, prof->signature[0] ? prof->signature : "No bio");
    refresh_weather_ui();
}

lv_obj_t *make_label(lv_obj_t *parent, const lv_font_t *font, uint32_t color,
                     lv_text_align_t align) {
    lv_obj_t *label = lv_label_create(parent);
    lv_obj_set_style_text_font(label, font, 0);
    lv_obj_set_style_text_color(label, lv_color_hex(color), 0);
    lv_obj_set_style_text_align(label, align, 0);
    return label;
}

// Passport paper details are drawn on demand without retained child objects.
void draw_passport_details(lv_event_t *event) {
    pixel_scene::Ink ink(event);
    // Open portrait and perforated seam replace retained decoration objects.
    const uint32_t surface = ui_theme_color_on_dark(UI_COLOR_SURFACE);
    ink.box(116, 28, 118, 93, surface);
    ink.box(116, 128, 118, 108, surface);
    for (int y = 34; y < 234; y += 8) ink.box(110, y, 1, 3, kPhosBorder);
    ink.box(14, 32, 14, 2, kPhosBorder); ink.box(14, 32, 2, 12, kPhosBorder);
    ink.box(88, 158, 14, 2, kPhosBorder); ink.box(100, 148, 2, 12, kPhosBorder);
    ink.box(14, 172, 24, 2, kPhos);
    ink.box(42, 172, 60, 1, kPhosBorder);
    for (int i = 0; i < 18; ++i) ink.box(14 + i * 5, 226, i % 3 ? 1 : 2, i % 4 ? 5 : 8, kPhosBorder);
    ink.box(120, 162, 110, 1, kPhosBorder);
}

void create_ui() {
    s_screen = lv_obj_create(nullptr);
    lv_obj_set_style_pad_all(s_screen, 0, 0);
    lv_obj_clear_flag(s_screen, LV_OBJ_FLAG_SCROLLABLE);
    lv_obj_set_style_bg_color(s_screen, lv_color_hex(kBg), 0);
    lv_obj_set_style_border_width(s_screen, 0, 0);

    // ---- Status bar (y0..24): Wi-Fi signal + battery, back at the very top ----
    lv_obj_t *top = ui_pixel_top_bar(s_screen);
    if (ui_theme_get() == UI_THEME_PLAYFUL) {
        ui_pixel_bg_color(top, kBg);
        lv_obj_set_style_border_color(top, lv_color_hex(kPhosBorder), 0);
    }
    ui_pixel_wifi_bars_create(s_screen, 12, 18, s_wifi_bars);
    s_batt = ui_pixel_battery_create(s_screen, 206, 6, kPhos, &lv_font_montserrat_14);

    lv_obj_t *passport = ui_pixel_label(s_screen, "PASSPORT", &lv_font_montserrat_14, kPhosDim);
    lv_obj_set_pos(passport, 42, 4);

    lv_obj_add_event_cb(s_screen, draw_passport_details, LV_EVENT_DRAW_MAIN, nullptr);

    // ---- Left area: portrait + name + signature (free-standing, open, no box) ----
    // Portrait area 96x138
    lv_obj_t *zone = px_container(s_screen, 12, 30, 96, 138);
    lv_obj_set_style_border_width(zone, 0, 0);
    lv_obj_set_style_bg_opa(zone, LV_OPA_TRANSP, 0);

    s_avatar_img = lv_image_create(zone);
    lv_obj_set_pos(s_avatar_img, 0, 0);
    lv_obj_set_size(s_avatar_img, HOME_PORTRAIT_W, HOME_PORTRAIT_H);
    lv_image_set_inner_align(s_avatar_img, LV_IMAGE_ALIGN_CENTER);
    // The A8 alpha image is filled solid with the recolor color (LVGL software-rendering fast path, checked against lv_draw_sw_img.c)
    lv_obj_set_style_image_recolor_opa(s_avatar_img, LV_OPA_TRANSP, 0);

    s_portrait_ph = make_label(zone, &buddy_font_16, kPhosDim, LV_TEXT_ALIGN_CENTER);
    lv_obj_set_width(s_portrait_ph, 92);
    lv_obj_align(s_portrait_ph, LV_ALIGN_CENTER, 0, 0);
    lv_label_set_text(s_portrait_ph, "No avatar");

    s_lbl_name = make_label(s_screen, &buddy_font_16, kPhos, LV_TEXT_ALIGN_LEFT);
    lv_obj_set_style_text_letter_space(s_lbl_name, UI_LS_BODY, 0);
    lv_obj_set_size(s_lbl_name, 90, 20);
    lv_label_set_long_mode(s_lbl_name, LV_LABEL_LONG_MODE_DOTS);
    lv_obj_set_pos(s_lbl_name, 14, 182);

    s_lbl_sig = make_label(s_screen, &buddy_font_16, kPhosDim, LV_TEXT_ALIGN_LEFT);
    lv_obj_set_size(s_lbl_sig, 90, 20);
    lv_label_set_long_mode(s_lbl_sig, LV_LABEL_LONG_MODE_DOTS);
    lv_obj_set_pos(s_lbl_sig, 14, 204);
    lv_label_set_text(s_lbl_name, "No name");
    lv_label_set_text(s_lbl_sig, "No bio");

    // ---- Top-right clock area (x114..234, y26..124): dot-matrix clock + date + city (comfortable breathing room) ----
    static const int slot_x[5] = {118, 145, 173, 180, 207};
    for (int i = 0; i < 5; ++i) {
        s_clk_slots[i] = px_container(s_screen, slot_x[i], 32,
                                      i == 2 ? 4 : kDigitW, kClockH);
        if (i != 2) lv_obj_add_event_cb(s_clk_slots[i], draw_digit_event,
                                       LV_EVENT_DRAW_MAIN, &s_clk_slot_char[i]);
    }
    s_clk_colon[0] = px_block(s_clk_slots[2], 0, 7, 4, 4, kClock);
    s_clk_colon[1] = px_block(s_clk_slots[2], 0, 21, 4, 4, kClock);

    // Date moved down to y=76, leaving a comfortable 9px gap from the bottom of the big clock
    s_lbl_date = make_label(s_screen, &buddy_font_16, kPhos, LV_TEXT_ALIGN_LEFT);
    lv_obj_set_width(s_lbl_date, 114);
    lv_obj_set_pos(s_lbl_date, 120, 77);

    // Location pin + city name (y=98..114)
    px_block(s_screen, 118, 102, 6, 6, kPhos);
    px_block(s_screen, 120, 108, 2, 3, kPhos);
    s_lbl_city = make_label(s_screen, &buddy_font_16, kPhosDim, LV_TEXT_ALIGN_LEFT);
    lv_obj_set_pos(s_lbl_city, 128, 98);
    lv_obj_set_size(s_lbl_city, 96, 20);
    lv_label_set_long_mode(s_lbl_city, LV_LABEL_LONG_MODE_DOTS);

    // ---- Lower-right environment weather area (x114..234, y124..236: classic three-row large-text layout) ----
    // Row 1: weather icon + big temperature + weather status
    s_wicon_zone = px_container(s_screen, 115, 137, 22, 18);
    s_lbl_temp = make_label(s_screen, &lv_font_montserrat_20, kTemperature, LV_TEXT_ALIGN_LEFT);
    lv_obj_set_pos(s_lbl_temp, 138, 133);
    lv_obj_set_size(s_lbl_temp, 42, 24);
    lv_label_set_long_mode(s_lbl_temp, LV_LABEL_LONG_MODE_CLIP);

    s_lbl_wtext = make_label(s_screen, &buddy_font_16, kWeatherAccent, LV_TEXT_ALIGN_LEFT);
    // Weather phrases are kept to about 50px or less in buddy_font_16 (label is 52px wide).
    // Bound the height as well: DOTS on a content-height label can still wrap.
    lv_obj_set_pos(s_lbl_wtext, 182, 136);
    lv_obj_set_size(s_lbl_wtext, 52, 20);
    lv_obj_set_style_text_letter_space(s_lbl_wtext, 0, 0);
    lv_label_set_long_mode(s_lbl_wtext, LV_LABEL_LONG_MODE_DOTS);

    // Three clear vertical weather metrics (y=170, 192, 214), using the 16px buddy_font_16 for comfort and clarity
    s_lbl_humidity = make_label(s_screen, &buddy_font_16, kPhosDim, LV_TEXT_ALIGN_LEFT);
    lv_obj_set_pos(s_lbl_humidity, 118, 170);
    lv_obj_set_size(s_lbl_humidity, 112, 20);
    lv_label_set_long_mode(s_lbl_humidity, LV_LABEL_LONG_MODE_DOTS);

    s_lbl_wind = make_label(s_screen, &buddy_font_16, kPhosDim, LV_TEXT_ALIGN_LEFT);
    lv_obj_set_pos(s_lbl_wind, 118, 192);
    lv_obj_set_size(s_lbl_wind, 112, 20);
    lv_label_set_long_mode(s_lbl_wind, LV_LABEL_LONG_MODE_DOTS);

    s_lbl_stat = make_label(s_screen, &buddy_font_16, kPhosDim, LV_TEXT_ALIGN_LEFT);
    lv_obj_set_pos(s_lbl_stat, 118, 214);
    lv_obj_set_size(s_lbl_stat, 112, 20);
    lv_label_set_long_mode(s_lbl_stat, LV_LABEL_LONG_MODE_DOTS);

    s_lbl_feels = nullptr;

    lv_label_set_text(s_lbl_temp, "--");
    lv_label_set_text(s_lbl_wtext, "");
    lv_label_set_text(s_lbl_humidity, "Humid --");
    lv_label_set_text(s_lbl_stat, "PM2.5 --");
    ui_pixel_label_set_text(s_lbl_wind, "Wind --");

    // ---- Bottom art image (y240..320): A8 alpha image + phosphor green recolor, full-width bleed ----
    s_band_img = lv_image_create(s_screen);
    lv_image_set_src(s_band_img, &s_band_dsc[s_band_index]);
    lv_obj_set_pos(s_band_img, 0, 240);
    lv_obj_set_style_image_recolor(s_band_img, lv_color_hex(kBand), 0);

    // ---- Key hints: black bottom strip + 1px thin divider + raised 6px safety margin ----
    px_block(s_screen, 0, 292, 240, 1, kPhosBorder);
    lv_obj_t *strip = px_block(s_screen, 0, 293, 240, 27, kBg);
    lv_obj_set_style_bg_opa(strip, LV_OPA_COVER, 0);
    s_lbl_footer = make_label(s_screen, &buddy_font_16, kPhosDim, LV_TEXT_ALIGN_CENTER);
    lv_obj_set_width(s_lbl_footer, kContentW);
    lv_obj_align(s_lbl_footer, LV_ALIGN_BOTTOM_MID, 0, -6);
    lv_label_set_long_mode(s_lbl_footer, LV_LABEL_LONG_MODE_DOTS);
    lv_label_set_text(s_lbl_footer, "Up:card Dn:info OK:apps");
}

constexpr uint16_t kJpegMcuHeight = 16;
constexpr std::size_t kJpegWorkSize = 4096;

struct ShareJpegContext {
    FILE *fp;
    uint16_t *stripe;
    uint16_t width;
    uint16_t height;
    bool color_pending;
    bool failed;
};

std::size_t share_jpeg_input(JDEC *decoder, uint8_t *buffer, std::size_t requested) {
    auto *context = static_cast<ShareJpegContext *>(decoder->device);
    if (!context || !context->fp) return 0;
    if (buffer) {
        return std::fread(buffer, 1, requested, context->fp);
    } else {
        return std::fseek(context->fp, static_cast<long>(requested), SEEK_CUR) == 0 ? requested : 0;
    }
}

int share_jpeg_output(JDEC *decoder, void *bitmap, JRECT *rectangle) {
    auto *context = static_cast<ShareJpegContext *>(decoder->device);
    if (!context || !bitmap || !rectangle || context->failed) return 0;

    const uint16_t block_width = rectangle->right - rectangle->left + 1;
    const uint16_t block_height = rectangle->bottom - rectangle->top + 1;
    if (rectangle->right >= context->width || rectangle->bottom >= context->height) {
        context->failed = true;
        return 0;
    }

    if (rectangle->left == 0 && context->color_pending) {
        if (bsp_display_io()) {
            esp_lcd_panel_io_tx_param(bsp_display_io(), 0x00, nullptr, 0);
        }
        context->color_pending = false;
    }

    uint16_t *target = context->stripe;
    if (!target) {
        context->failed = true;
        return 0;
    }

    // TJPGD output format is BGR888
    const auto *bgr = static_cast<const uint8_t *>(bitmap);
    for (uint16_t y = 0; y < block_height; ++y) {
        uint16_t *row = target + static_cast<std::size_t>(y) * context->width;
        for (uint16_t x = 0; x < block_width; ++x) {
            const std::size_t input = (static_cast<std::size_t>(y) * block_width + x) * 3U;
            const uint16_t color = static_cast<uint16_t>(
                ((bgr[input + 2] & 0xf8U) << 8U) |
                ((bgr[input + 1] & 0xfcU) << 3U) |
                (bgr[input] >> 3U));
            row[rectangle->left + x] = __builtin_bswap16(color);
        }
    }

    if (rectangle->right + 1U == context->width) {
        const uint16_t panel_top = rectangle->top;
        const uint16_t panel_bottom = rectangle->bottom + 1U;
        if (esp_lcd_panel_draw_bitmap(bsp_display_panel(), 0, panel_top,
                                      context->width, panel_bottom, target) != ESP_OK) {
            context->failed = true;
            return 0;
        }
        context->color_pending = true;
    }
    return 1;
}

bool home_show_share_image() {
    char path[HOME_SHARE_PATH_MAX];
    if (!home_profile_share_path_at(s_share_index, path, sizeof(path))) return false;
    FILE *fp = std::fopen(path, "rb");
    if (!fp) {
        ESP_LOGW(kTag, "Cannot open share image: %s", path);
        return false;
    }

    auto *work = static_cast<uint8_t *>(std::malloc(kJpegWorkSize));
    auto *stripe = static_cast<uint16_t *>(
        std::malloc(HOME_SHARE_W * kJpegMcuHeight * sizeof(uint16_t)));
    if (!work || !stripe) {
        ESP_LOGE(kTag, "Alloc failed for share JPEG decoding");
        if (work) std::free(work);
        if (stripe) std::free(stripe);
        std::fclose(fp);
        return false;
    }

    ShareJpegContext context = {
        .fp = fp,
        .stripe = stripe,
        .width = HOME_SHARE_W,
        .height = HOME_SHARE_H,
        .color_pending = false,
        .failed = false,
    };

    JDEC decoder;
    JRESULT res = jd_prepare(&decoder, share_jpeg_input, work, kJpegWorkSize, &context);
    if (res != JDR_OK) {
        ESP_LOGW(kTag, "jd_prepare failed: %d", res);
        std::free(work);
        std::free(stripe);
        std::fclose(fp);
        return false;
    }

    if (decoder.width > HOME_SHARE_W || decoder.height > HOME_SHARE_H) {
        ESP_LOGW(kTag, "Share image dimensions (%ux%u) exceed max (%ux%u)",
                 decoder.width, decoder.height, HOME_SHARE_W, HOME_SHARE_H);
        std::free(work);
        std::free(stripe);
        std::fclose(fp);
        return false;
    }
    context.width = decoder.width;
    context.height = decoder.height;

    res = jd_decomp(&decoder, share_jpeg_output, 0);
    std::fclose(fp);

    if (context.color_pending && bsp_display_io()) {
        esp_lcd_panel_io_tx_param(bsp_display_io(), 0x00, nullptr, 0);
    }

    std::free(work);
    std::free(stripe);

    if (res != JDR_OK || context.failed) {
        ESP_LOGW(kTag, "jd_decomp failed: %d (failed=%d)", res, context.failed);
        return false;
    }

    ESP_LOGI(kTag, "Wallet card displayed: %ux%u color JPEG index=%u free=%u largest=%u",
        decoder.width, decoder.height, s_share_index, (unsigned)esp_get_free_heap_size(),
        (unsigned)heap_caps_get_largest_free_block(MALLOC_CAP_INTERNAL));
    return true;
}

void toggle_share_view() {
    if (s_share_visible) {
        bsp_lvgl_lock(-1);
        s_share_visible = false;
        lv_display_t *disp = lv_display_get_default();
        if (disp) lv_display_enable_invalidation(disp, true);
        if (s_screen) lv_obj_invalidate(s_screen);
        bsp_lvgl_unlock();
        return;
    }

    if (!home_profile_has_share_image()) {
        ESP_LOGW(kTag, "UP: no valid wallet card file");
        // Keep the original manual weather refresh ability while no pocket card has been uploaded yet.
        s_force_weather.store(true);
        return;
    }

    bsp_lvgl_lock(-1);
    s_share_index = 0;
    s_share_visible = true;
    lv_display_t *disp = lv_display_get_default();
    if (disp) lv_display_enable_invalidation(disp, false);
    bsp_lvgl_unlock();

    // Do file reads and chunked direct-to-screen pushes outside the lock
    if (!home_show_share_image()) {
        bsp_lvgl_lock(-1);
        s_share_visible = false;
        if (disp) lv_display_enable_invalidation(disp, true);
        if (s_screen) lv_obj_invalidate(s_screen);
        bsp_lvgl_unlock();
    }
}

// Long-press Up: cycle the bottom art image (city night -> mountain lake moonlight; a user upload slot may be added later).
void band_art_next(void) {
    s_band_index = (s_band_index + 1) % 2;
    if (s_band_img) {
        lv_image_set_src(s_band_img, &s_band_dsc[s_band_index]);
    }
}

void home_task(void *arg) {
    (void)arg;
    const int64_t start_ms = esp_timer_get_time() / 1000;
    int64_t upload_started_ms = 0;
    bool upload_ps_high = false; // Whether upload mode has switched to the BALANCED power-save profile
    bool clock_on = false;
    uint32_t last_profile_ver = home_profile_version();
    home_profile_t prof;
    home_profile_get(&prof);

    while (s_home_active.load()) {
        const int64_t now_ms = esp_timer_get_time() / 1000;

        if (bsp_lvgl_lock(1000)) {
            if (s_ui_alive.load() && app_registry_screen_is_on() && !s_share_visible) {
                update_clock_labels();
                update_battery_label();
                update_wind_line();
                // The bottom row is recomputed every second: in upload mode it fills the freshly obtained IP into the URL,
                // avoiding an empty http:// shown when "Wi-Fi just connected but no address yet".
                update_footer_label();
                weather_icon_spin_tick();
            }
            bsp_lvgl_unlock();
        }

        // Run SNTP only when Wi-Fi is ready; stop it on disconnect so lwIP does not keep retrying.
        const bool connected = WifiManager::GetInstance().IsConnected();
        if (connected && !clock_on) {
            home_clock_start();
            clock_on = true;
        } else if (!connected && clock_on) {
            home_clock_stop();
            clock_on = false;
        }

        // Profile (incl. avatar) changed: do file IO outside the lock first, then update the UI under the lock.
        const uint32_t profile_ver = home_profile_version();
        if (profile_ver != last_profile_ver) {
            last_profile_ver = profile_ver;
            char previous_lat[HOME_COORD_MAX], previous_lon[HOME_COORD_MAX];
            std::snprintf(previous_lat, sizeof(previous_lat), "%s", prof.lat);
            std::snprintf(previous_lon, sizeof(previous_lon), "%s", prof.lon);
            home_profile_get(&prof);
            if (std::strcmp(previous_lat, prof.lat) || std::strcmp(previous_lon, prof.lon))
                s_force_weather.store(true);
            const bool has = home_profile_has_avatar();
            esp_err_t err = ESP_FAIL;
            if (has) err = read_portrait(true);
            if (bsp_lvgl_lock(1000)) {
                if (s_ui_alive.load()) {
                    apply_profile(&prof);
                    apply_avatar(err == ESP_OK);
                }
                bsp_lvgl_unlock();
            }
        }

        // First entry delays 15s; a 30-minute sample is reused across pages; manual refresh or a city change requests immediately.
        home_profile_get(&prof);
        const unsigned requests = connected ? s_weather_schedule.due(now_ms, start_ms, s_force_weather.load(), prof) : 0;
        if (requests) {
            s_force_weather.store(false);
            s_weather_schedule.begin(requests, now_ms, prof);
            // While fetching, the weather card shows a four-dot spinner on the left (one step per second); after it ends the icon is swapped per the result
            s_weather_fetching = true;
            if (bsp_lvgl_lock(1000)) {
                refresh_weather_ui();
                bsp_lvgl_unlock();
            }
            if (requests & WeatherSchedule::Weather) {
                const auto result = home_weather_refresh(prof.lat, prof.lon); // Blocks for several seconds, lock not held
                if (s_home_active.load()) s_weather_schedule.finish(WeatherSchedule::Weather, esp_timer_get_time() / 1000, result);
            }
            if (s_home_active.load() && (requests & WeatherSchedule::Air)) {
                const auto result = home_air_quality_refresh(prof.lat, prof.lon);
                if (s_home_active.load()) s_weather_schedule.finish(WeatherSchedule::Air, esp_timer_get_time() / 1000, result);
            }
            s_weather_fetching = false;
            if (!s_home_active.load()) break;
            // Refresh once regardless of success: success swaps the weather icon, failure takes the spinner down
            if (bsp_lvgl_lock(1000)) {
                refresh_weather_ui();
                bsp_lvgl_unlock();
            }
        }

        // In upload mode restore immediate downlink (phone/device round trips must be fast); on exit return to the standby power-save profile.
        // Detected by level change, so both the key-triggered start and the 10-minute auto timeout paths are covered.
        const bool upload_active = home_upload_active();
        if (upload_active != upload_ps_high) {
            upload_ps_high = upload_active;
            WifiManager::GetInstance().SetPowerSaveLevel(
                upload_active ? WifiPowerSaveLevel::BALANCED : WifiPowerSaveLevel::LOW_POWER);
        }

        // Upload mode closes automatically after 10 minutes, so httpd does not hold memory for long.
        if (home_upload_active()) {
            if (upload_started_ms == 0) {
                upload_started_ms = now_ms;
            } else if (now_ms - upload_started_ms >= kUploadTimeoutMs) {
                home_upload_stop();
                upload_started_ms = 0;
            }
        } else {
            upload_started_ms = 0;
        }

        // The 1s period is split into 10x100ms: after stop() the task exits within <=100ms, so app switching no longer
        // waits a full second -- the black-screen transition into Xiaozhi / Radio is noticeably shorter.
        for (int i = 0; i < 10 && s_home_active.load(); ++i) {
            vTaskDelay(pdMS_TO_TICKS(100));
        }
    }

    s_task_handle = nullptr;
    s_worker_running.store(false);
    vTaskDelete(NULL);
}

void home_init() {
    home_profile_init();
    home_weather_init();
    // Only the voice app has called time_sync_init(); Home calls it once itself to make sure the timezone is loaded (idempotent NVS read).
    time_sync_init();

    // The LVGL 9 header is a bitfield struct; assigning field by field is safer than designated initializers (avoids bitfield init-order issues).
    // Indexed colors preserve four foreground tones independently of transparency.
    s_portrait_dsc.header.magic = LV_IMAGE_HEADER_MAGIC;
    s_portrait_dsc.header.cf = LV_COLOR_FORMAT_I4;
    s_portrait_dsc.header.flags = 0;
    s_portrait_dsc.header.w = HOME_PORTRAIT_W;
    s_portrait_dsc.header.h = HOME_PORTRAIT_H;
    s_portrait_dsc.header.stride = HOME_PORTRAIT_W / 2;
    s_portrait_dsc.data_size = HOME_PORTRAIT_I4_BYTES;
    s_portrait_dsc.data = s_portrait_pixels;

    // Built-in art (A8, data in flash, zero RAM use)
    const uint8_t *band_data[2] = {kBandArtCity, kBandArtMountain};
    for (int i = 0; i < 2; ++i) {
        s_band_dsc[i].header.magic = LV_IMAGE_HEADER_MAGIC;
        s_band_dsc[i].header.cf = LV_COLOR_FORMAT_A8;
        s_band_dsc[i].header.flags = 0;
        s_band_dsc[i].header.w = BAND_ART_W;
        s_band_dsc[i].header.h = BAND_ART_H;
        s_band_dsc[i].header.stride = BAND_ART_W;
        s_band_dsc[i].data_size = BAND_ART_W * BAND_ART_H;
        s_band_dsc[i].data = band_data[i];
    }

    ESP_LOGI(kTag, "Home app subsystems ready");
}

void home_start() {
    ESP_LOGI(kTag, "Starting Home app");
    home_weather_allow_requests();
    s_home_active.store(true);
    s_ui_alive.store(true);
    s_detail_mode = 0;
    s_share_visible = false;

    // Read the first-screen profile and portrait before taking the lock: the first SPIFFS mount can take tens of ms and must not block the LVGL task.
    // Allocate expanded pixels only when an uploaded portrait actually exists.

    home_profile_t prof;
    home_profile_get(&prof);
    const bool has_avatar = home_profile_has_avatar();
    const esp_err_t avatar_err =
        read_portrait(has_avatar);

    bsp_lvgl_lock(-1);
    if (!s_screen) create_ui();
    apply_profile(&prof);
    apply_avatar(avatar_err == ESP_OK);
    update_clock_labels();
    update_battery_label();
    update_wind_line();
    update_footer_label();
    lv_scr_load(s_screen);
    bsp_lvgl_unlock();

    // Stack is 8192 rather than the 4096 in the docs: this task runs HTTPS (the mbedTLS handshake call chain is deep),
    // a 4KB stack risks overflow during certificate verification; also the weather icon goes through the LVGL TJPEG decoder_info
    // (file source), which puts the 4KB TJPGD_WORKBUFF_SIZE on the stack (lv_tjpgd.c:110),
    // 6144 was measured to overflow after a toolchain change (Stack protection fault, 2026-09-13).
    s_worker_running.store(true);
    BaseType_t created = xTaskCreate(home_task, "home_app", 8192, NULL, 4, &s_task_handle);
    if (created != pdPASS) {
        s_worker_running.store(false);
        s_task_handle = nullptr;
        ESP_LOGE(kTag, "Failed to create home task; free heap: %u KB",
                 (unsigned)(esp_get_free_heap_size() / 1024));
        return;
    }
    ESP_LOGI(kTag, "Home app started; free heap: %u KB",
             (unsigned)(esp_get_free_heap_size() / 1024));
}

bool home_prepare_stop() {
    s_home_active.store(false);
    s_ui_alive.store(false);
    home_weather_cancel_requests();
    return !s_worker_running.load();
}

void home_stop() {
    ESP_LOGI(kTag, "Stopping Home app");
    s_home_active.store(false);
    home_weather_cancel_requests();
    // Clear the UI flag first: home_task checks it before refreshing under the lock, avoiding "task still writes labels after the screen is deleted".
    s_ui_alive.store(false);

    // Registry calls this only after prepare_stop reports completion. Never
    // delete a task inside DNS/TLS: it may still own heap or socket locks.
    if (!home_prepare_stop()) return;

    home_upload_stop();
    home_clock_stop();

    bsp_lvgl_lock(-1);
    if (s_screen) {
        lv_obj_delete(s_screen);
    }
    s_screen = nullptr;
    s_avatar_img = nullptr;
    s_portrait_ph = nullptr;
    s_lbl_date = nullptr;
    for (lv_obj_t *&bar : s_wifi_bars) bar = nullptr;
    s_batt = {nullptr, nullptr};
    s_band_img = nullptr;
    for (lv_obj_t *&slot : s_clk_slots) slot = nullptr;
    for (lv_obj_t *&dot : s_clk_colon) dot = nullptr;
    std::memset(s_clk_slot_char, 0, sizeof(s_clk_slot_char));
    s_lbl_name = nullptr;
    s_lbl_sig = nullptr;
    s_wicon_zone = nullptr;
    // The weather icon blocks were destroyed along with the screen; only clear the registration state here, do not lv_obj_delete again
    for (lv_obj_t *&o : s_wicon_objs) o = nullptr;
    s_wicon_n = 0;
    for (lv_obj_t *&b : s_spin) b = nullptr;
    s_wicon_spinning = false;
    s_lbl_city = nullptr;
    s_lbl_wtext = nullptr;
    s_lbl_temp = nullptr;
    s_lbl_humidity = nullptr;
    s_lbl_wind = nullptr;
    s_lbl_feels = nullptr;
    s_lbl_stat = nullptr;
    s_lbl_footer = nullptr;
    if (s_share_visible) {
        lv_display_t *disp = lv_display_get_default();
        if (disp) lv_display_enable_invalidation(disp, true);
        s_share_visible = false;
    }
    lv_image_cache_drop(&s_portrait_dsc);
    bsp_lvgl_unlock();

    // Screen deleted and task exited, so the portrait buffer can go back to the heap -- other apps (Xiaozhi) are waiting for
    // this contiguous memory to open the Opus encoder. dsc.data is cleared too, to avoid dangling references.
    if (s_portrait_pixels != nullptr) {
        free(s_portrait_pixels);
        s_portrait_pixels = nullptr;
        s_portrait_dsc.data = nullptr;
    }

    free(s_portrait_packed);
    s_portrait_packed = nullptr;
    ESP_LOGI(kTag, "Home app stopped. Free heap: %u KB",
             (unsigned)(esp_get_free_heap_size() / 1024));
}

void home_on_key(uint8_t btn, app_btn_event_t event, uint16_t mv) {
    (void)mv;

    // Phone setup and first boot share the same hotspot entry.
    if (btn == BSP_BTN_DOWN && event == BTN_EVT_LONG) {
        app_registry_switch_to(APP_ID_WIFI);
        return;
    }

    // Long-press UP = switch the bottom art image.
    if (btn == BSP_BTN_UP && event == BTN_EVT_LONG) {
        if (s_share_visible) return;
        bsp_lvgl_lock(-1);
        band_art_next();
        bsp_lvgl_unlock();
        return;
    }

    if (event != BTN_EVT_CLICK) return;

    if (s_share_visible && (btn == BSP_BTN_UP || btn == BSP_BTN_DOWN)) {
        home_share_gallery_t gallery;
        if (home_profile_gallery_get(&gallery) == ESP_OK && gallery.count > 1) {
            const uint8_t previous = s_share_index;
            s_share_index = (s_share_index + gallery.count + (btn == BSP_BTN_UP ? -1 : 1)) % gallery.count;
            if (!home_show_share_image()) {
                s_share_index = previous;
                if (!home_show_share_image()) toggle_share_view();
            }
        }
        return;
    }

    // Short-press OK = open the app grid.
    if (btn == BSP_BTN_OK) {
        if (s_share_visible) {
            toggle_share_view();
            return;
        }
        if (s_detail_mode == 2) {
            const int64_t now = esp_timer_get_time() / 1000;
            bsp_lvgl_lock(-1);
            if (now - s_manual_weather_ms >= 30000 && WifiManager::GetInstance().IsConnected()) {
                s_manual_weather_ms = now;
                s_force_weather.store(true);
                footer_set("Updating weather", &buddy_font_16, kPhos);
            } else {
                footer_set("Try again later", &buddy_font_16, kPhos);
            }
            bsp_lvgl_unlock();
            return;
        }
        ESP_LOGI(kTag, "Opening app drawer from Home");
        app_registry_switch_to(APP_ID_LAUNCHER);
        return;
    }

    if (btn == BSP_BTN_UP) {
        toggle_share_view();
        return;
    } else if (btn == BSP_BTN_DOWN) {
        if (s_share_visible) {
            toggle_share_view();
            return;
        }
        // Hints, gestures, network/weather, PM2.5 units and data sources.
        s_detail_mode = static_cast<uint8_t>((s_detail_mode + 1) % 5);
    } else {
        return;
    }

    bsp_lvgl_lock(-1);
    update_footer_label();
    bsp_lvgl_unlock();
}

}  // namespace

const passport_app_t g_home_app = {
    .id = APP_ID_HOME,
    .name = "Home",
    .en_name = "HOME",
    .desc = "Clock, weather, card, upload",
    .tag = "Direct",
    .theme_color = 0xDDB36C,
    .init = home_init,
    .start = home_start,
    .stop = home_stop,
    .on_key = home_on_key,
    .prepare_stop = home_prepare_stop,
};
